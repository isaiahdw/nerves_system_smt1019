## package/aic8800/Config.in
```kconfig
config BR2_PACKAGE_AIC8800
	bool "aic8800"
	depends on BR2_LINUX_KERNEL
	help
	  AICSemi AIC8800 SDIO WiFi driver (aic8800_bsp + aic8800_fdrv
	  kernel modules, built from the Rockchip SDK's
	  external/rkwifibt sources) and firmware. Used by SMT1019
	  units fitted with the AIC8800D80 radio (SDIO c8a1:0082)
	  instead of the AP6281S.

	  The Bluetooth module (aic8800_btlpm) is not built.
```

## package/ap6281-firmware/Config.in
```kconfig
config BR2_PACKAGE_AP6281_FIRMWARE
	bool "ap6281-firmware"
	help
	  WiFi firmware for the Broadcom/Synaptics AP6281S (BCM43013/SYN4381)
	  SDIO module: firmware, nvram, CLM blobs, Bluetooth .hcd, and the
	  bcmdhd config.txt. Extracted from the vendor's reference Debian
	  image (byte-identical to the working system). The driver itself is
	  the in-kernel bcmdhd (CONFIG_AP6XXX).
```

## package/camsnap/Config.in
```kconfig
config BR2_PACKAGE_CAMSNAP
	bool "camsnap"
	select BR2_PACKAGE_JPEG
	help
	  Camera live-view + calibration daemon for the SMT1019 (rkisp
	  mainpath -> /dev/shm/cam.jpg + cam_stats.json).
```

## package/rkaiq/Config.in
```kconfig
config BR2_PACKAGE_RKAIQ
	bool "rkaiq"
	help
	  Rockchip camera 3A engine (rkaiq_3A_server + librkaiq) with the
	  GC5035 IQ tuning files in /etc/iqfiles. Prebuilt binaries; see
	  README.md in this package for the build recipe and ABI patch.
```

## package/smt-audio-dsp/Config.in
```kconfig
config BR2_PACKAGE_SMT_AUDIO_DSP
	bool "smt-audio-dsp"
	select BR2_PACKAGE_ALSA_PLUGINS
	help
	  Custom LADSPA plugin (smt_hpf_limiter) for the SMT1019's 2 W
	  built-in speakers: a 4th-order Butterworth high-pass, a 3-band
	  voicing EQ (warmth/presence/air), and a makeup-gain tanh
	  soft-limiter.

	  The high-pass removes the low-frequency content the small drivers
	  over-excurse on, the EQ voices the boxy 40 mm drivers, and the
	  makeup gain + soft limiter raise music RMS toward the digital
	  ceiling for loudness without hard clipping.

	  Installs /usr/lib/ladspa/smt_audio_dsp.so, loaded by the ALSA
	  `type ladspa` PCM plugin (alsa-plugins) via /etc/asound.conf so
	  every audio stream is filtered transparently.
```
